## hab/conf/layer.conf
```bitbake
BBPATH =. "${LAYERDIR}:"
BBFILES += "${LAYERDIR}/recipes/*/*.bb \
            ${LAYERDIR}/recipes/*.bbappend"
BBFILE_COLLECTIONS += "hablayer"
BBFILE_PATTERN_hablayer = "^${LAYERDIR}/"
BBFILE_PATTERN_IGNORE_EMPTY_hablayer = "1"
BBFILE_PRIORITY_hablayer = "99"
LAYERSERIES_COMPAT_hablayer = "${LAYERSERIES_COMPAT_core}"

HOSTTOOLS += " hexdump awk "

CORE_IMAGE_EXTRA_INSTALL += " cst-tools "
IMAGE_BOOT_FILES_cl-som-imx7 += "zImage.signed"
```

## imx7/conf/layer.conf
```bitbake
# Copyright 2020 CompuLab LTD

# We have a conf and classes directory, add to BBPATH
BBPATH .= ":${LAYERDIR}"

# We have recipes-* directories, add to BBFILES
BBFILES += "${LAYERDIR}/recipes-*/*/*.bb \
	${LAYERDIR}/recipes-*/*/*.bbappend"

BBFILE_COLLECTIONS += "mender-compulab-imx7"
BBFILE_PATTERN_mender-compulab-imx7 = "^${LAYERDIR}/"
BBFILE_PRIORITY_mender-compulab-imx7 = "10"

LAYERSERIES_COMPAT_mender-compulab-imx7 = "sumo warrior"
```

## imx7/debian/conf/layer.conf
```bitbake
# Copyright 2021 CompuLab LTD

# We have a conf and classes directory, add to BBPATH
BBPATH .= ":${LAYERDIR}"

# We have recipes-* directories, add to BBFILES
BBFILES += "${LAYERDIR}/recipes-*/*/*.bb \
	${LAYERDIR}/recipes-*/*/*.bbappend"

BBFILE_COLLECTIONS += "debian-helper"
BBFILE_PATTERN_debian-helper = "^${LAYERDIR}/"
BBFILE_PRIORITY_debian-helper = "10"

BBMASK += "${@bb.utils.contains('DISTRO_CODENAME', 'warrior',  '',   'recipes-helpers/linux-firmware/linux-firmware_git.bbappend', d)}"
BBMASK += "${@bb.utils.contains('DISTRO_CODENAME', 'warrior',  'recipes-helpers/mender/mender-client_%.bbappend',   'recipes-helpers/mender/mender_%.bbappend', d)}"

LAYERSERIES_COMPAT_debian-helper = "sumo warrior dunfell gatesgarth hardknott"
```

## imx8/conf/layer.conf
```bitbake
# Copyright 2020 CompuLab LTD

# We have a conf and classes directory, add to BBPATH
BBPATH .= ":${LAYERDIR}"

# We have recipes-* directories, add to BBFILES
BBFILES += "${LAYERDIR}/recipes-*/*/*.bb \
	${LAYERDIR}/recipes-*/*/*.bbappend"

BBFILE_COLLECTIONS += "mender-compulab-imx8"
BBFILE_PATTERN_mender-compulab-imx8 = "^${LAYERDIR}/"
BBFILE_PRIORITY_mender-compulab-imx8= "10"

BBMASK += "meta-compulab/recipes-xfce"

LAYERSERIES_COMPAT_mender-compulab-imx8 = "sumo warrior"

# mender stuff

MENDER_STORAGE_TOTAL_SIZE_MB = "1024"
MENDER_BOOT_PART_SIZE_MB = "32"

WKS_FILE_DEPENDS += " u-boot-script "

CORE_IMAGE_EXTRA_INSTALL += " cl-uboot cl-deploy bt-start htop iotop tmux iperf3 "

# ucm-imx8m-mini

MENDER_STORAGE_DEVICE_ucm-imx8m-mini = "/dev/mmcblk1"
KERNEL_DEVICETREE_ucm-imx8m-mini = "compulab/ucm-imx8m-mini.dtb"
IMAGE_BOOT_FILES_ucm-imx8m-mini = "boot.scr Image ucm-imx8m-mini.dtb "

# cl-som-imx8

MENDER_STORAGE_DEVICE_cl-som-imx8 = "/dev/mmcblk1"
KERNEL_DEVICETREE_cl-som-imx8 = "compulab/sbc-imx8.dtb"
IMAGE_BOOT_FILES_cl-som-imx8 = "boot.scr Image sbc-imx8.dtb "
```
