## conf/layer.conf
```bitbake
# We have a conf and classes directory, add to BBPATH
BBPATH .= ":${LAYERDIR}"

# We have recipes-* directories, add to BBFILES
BBFILES += "${LAYERDIR}/recipes-*/*/*.bb \
            ${LAYERDIR}/recipes-*/*/*.bbappend"

BBFILE_COLLECTIONS += "mender-compulab"
BBFILE_PATTERN_mender-compulab = "^${LAYERDIR}/"
BBFILE_PRIORITY_mender-compulab = "10"

LAYERDEPENDS_mender-compulab = "mender"

LAYERSERIES_COMPAT_mender-compulab = "scarthgap kirkstone"

BBMASK += "bt-start_%.bbappend"
BBMASK += "${@bb.utils.contains('BBFILE_COLLECTIONS', 'fsl-bsp-release', '', 'nnshark_%.bbappend', d)}"
BBMASK += "meta-compulab/recipes-desktop/cl-growfs-rootfs/cl-growfs-rootfs.bb"

CORE_IMAGE_EXTRA_INSTALL:append:compulab-mx8mp = " cl-bootcmd "

DISTRO_FEATURES:append = " compulab-uefi compulab-mender"

PREFERRED_VERSION:pn-mender-connect = "3.0.0"

IMAGE_BOOT_FILES:remove = " \
        imx93_m33_TCM_rpmsg_lite_pingpong_rtos_linux_remote.bin \
        imx93_m33_TCM_rpmsg_lite_str_echo_rtos.bin \
"
```
